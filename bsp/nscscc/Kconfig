## bsp/nscscc/Kconfig
```kconfig
mainmenu "RT-Thread Configuration"

config BSP_DIR
    string
    option env="BSP_ROOT"
    default "."

config RTT_DIR
    string
    option env="RTT_ROOT"
    default "../.."

config PKGS_DIR
    string
    option env="PKGS_ROOT"
    default "packages"

source "$RTT_DIR/Kconfig"
source "$RTT_DIR/libcpu/mips/common/Kconfig"
source "$PKGS_DIR/Kconfig"

config SOC_NSCSCC
    bool
    select RT_USING_COMPONENTS_INIT
    select RT_USING_USER_MAIN
    default y

choice
    prompt "Board Type"
        config RT_NSCSCC
            bool "NSCSCC SOC_RUN_OS"
endchoice

config RT_USING_SELF_BOOT
    bool "Enable RT-Thread run without bootloader"
    default n

if RT_USING_SELF_BOOT
    config RT_SELF_BOOT_DEBUG
    bool "Debug self boot code"
    default n
endif

if RT_USING_SERIAL
config RT_USING_UART0
    bool "Using RT_USING_UART0"
    default y

config RT_UART_RX_BUFFER_SIZE
    int "The rx buffer size"
    default 64 if RT_USING_SERIAL
    default 64
endif
```
